## CMakeLists.txt
```
# Zephyr Example Application

cmake_minimum_required(VERSION 3.20.0)

# The default board for this example is the b_u585i_iot02a, but can be
# overridden by passing --board=<board> to west or -DBOARD=<board> to cmake
set(BOARD b_u585i_iot02a)

find_package(Zephyr REQUIRED HINTS $ENV{ZEPHYR_BASE})

target_sources(app PRIVATE src/main.c src/cdr.c)
zephyr_include_directories(config)
project(memfault-app LANGUAGES C VERSION 1.0.0)
```

## Kconfig
```
source "Kconfig.zephyr"

# Application Kconfig file
#
# This is loaded when building this directory with west.
menu "Memfault Example Application Configuration"

config ZEPHYR_MEMFAULT_EXAMPLE_THREAD_TOGGLE
    bool "Example thread create + abort toggling every 10 seconds"
    default n
    help
      Enables creating and aborting an example thread every 10 seconds in the
      example app

config ZEPHYR_MEMFAULT_EXAMPLE_MEMORY_METRICS
    bool "Use metrics to monitor memory usage in the example app"
    default y
    depends on MEMFAULT && MEMFAULT_HEAP_STATS && THREAD_STACK_INFO

endmenu
```

## west.yml
```
# West manifest for Memfault Example Application

manifest:
  remotes:
    - name: zephyrproject-rtos
      url-base: https://github.com/zephyrproject-rtos
    - name: memfault
      url-base: https://github.com/memfault

  projects:
    - name: zephyr
      remote: zephyrproject-rtos
      revision: v3.6.0
      import:
        # Limit the Zephyr modules to the required set
        name-allowlist:
            - cmsis
            - picolibc
            - hal_stm32

    - name: memfault-firmware-sdk
      path: modules/lib/memfault-firmware-sdk
      remote: memfault
      # Note: normally this would be pinned to a specific SDK tag instead of
      # master
      revision: master
```

## prj.conf
```kconfig
# This file contains selected Kconfig options for the application.

# Memfault configuration
CONFIG_MEMFAULT=y
CONFIG_MEMFAULT_LOGGING_ENABLE=y

# Enable UART console and shell for testing memfault
CONFIG_CONSOLE=y
CONFIG_UART_CONSOLE=y
CONFIG_SHELL=y

CONFIG_LOG=y
# Using immediate mode to avoid dropping bursts of log messages, eg when running
# `mflt export` to dump base64-chunks to the console
CONFIG_LOG_MODE_IMMEDIATE=y
CONFIG_LOG_BACKEND_UART=y
# Disable shell log output to prevent duplicate logs, since UART backend is
# already enabled. Shell log backend enables later than UART backend, and won't
# show the boot splash messages, so it's simpler to just enable the UART
# backend. Note that the RTT backend is enabled by default- that's ok, and could
# be useful if the board doesn't have a UART available.
CONFIG_SHELL_LOG_BACKEND=n
# Disable logging of printk, to improve 'mflt export' performance under deferred
# logging mode.
CONFIG_LOG_PRINTK=n

# Enable heap stats explicitly. It's enabled by default when heap is enabled,
# see below, but in a default app, it won't be enabled because heap is disabled.
# For this reference example, we select it explicitly.
CONFIG_MEMFAULT_HEAP_STATS=y

# Increase the heap pool and main stack sizes for the example app. Setting a
# non-zero memory pool size is required for heap stats, otherwise there's no
# k_malloc used
CONFIG_HEAP_MEM_POOL_SIZE=4096
CONFIG_MAIN_STACK_SIZE=4096

# Enable Zephyr runtime asserts
CONFIG_ASSERT=y

# Enable Memfault Compact Logs
CONFIG_MEMFAULT_COMPACT_LOG=y

# Enable Memfault self test
CONFIG_MEMFAULT_SHELL_SELF_TEST=y
CONFIG_MEMFAULT_SHELL_SELF_TEST_COREDUMP_STORAGE=y

# Enable emulated RTC driver. Disabled by default because the RTC need to be
# explicitly updated at runtime to wall clock time, otherwise it will print
# errors.
# CONFIG_RTC=y
# CONFIG_RTC_EMUL=y
# CONFIG_RTC_SHELL=y

# Enable warnings as errors
CONFIG_COMPILER_WARNINGS_AS_ERRORS=y

CONFIG_HWINFO=y

CONFIG_SHELL=y

# Enable and configure logging
CONFIG_LOG=y
CONFIG_LOG_BACKEND_UART=y
# Disable the shell log backend. Rely on the configured backend instead (RTT,
# UART, etc.)
CONFIG_SHELL_LOG_BACKEND=n
```

## src/main.c
```c
//! @file
//!
//! Copyright (c) Memfault, Inc.
//! See License.txt for details
//!
//! Example app main

// clang-format off
#include "memfault/ports/zephyr/include_compatibility.h"

#include MEMFAULT_ZEPHYR_INCLUDE(device.h)
#include MEMFAULT_ZEPHYR_INCLUDE(devicetree.h)
#include MEMFAULT_ZEPHYR_INCLUDE(drivers/gpio.h)
#include MEMFAULT_ZEPHYR_INCLUDE(drivers/hwinfo.h)
#include MEMFAULT_ZEPHYR_INCLUDE(kernel.h)
#include MEMFAULT_ZEPHYR_INCLUDE(logging/log.h)
#include MEMFAULT_ZEPHYR_INCLUDE(shell/shell.h)

#include "app_version.h"

#include "cdr.h"
#include "memfault/components.h"
#include "memfault/ports/zephyr/core.h"
// clang-format on

LOG_MODULE_REGISTER(main, LOG_LEVEL_INF);

// Blink code taken from the zephyr/samples/basic/blinky example.
static void blink_forever(void) {
#if CONFIG_QEMU_TARGET
  k_sleep(K_FOREVER);
#else
  /* 1000 msec = 1 sec */
  #define SLEEP_TIME_MS 1000

  /* The devicetree node identifier for the "led0" alias. */
  #define LED0_NODE DT_ALIAS(led0)

  static const struct gpio_dt_spec led = GPIO_DT_SPEC_GET(LED0_NODE, gpios);

  int ret = gpio_pin_configure_dt(&led, GPIO_OUTPUT_ACTIVE);
  if (ret < 0) {
    return;
  }

  while (1) {
    gpio_pin_toggle_dt(&led);
    k_msleep(SLEEP_TIME_MS);
  }
#endif  // CONFIG_QEMU_TARGET
}

static const char *prv_get_device_id(void) {
  uint8_t dev_id[16] = { 0 };
  static char dev_id_str[sizeof(dev_id) * 2 + 1];
  static const char *dev_str = "UNKNOWN";

  // Obtain the device id
  ssize_t length = hwinfo_get_device_id(dev_id, sizeof(dev_id));

  // If this fails for some reason, use a fixed ID instead
  if (length <= 0) {
    dev_str = CONFIG_SOC_SERIES "-test";
    length = strlen(dev_str);
  } else {
    // Render the obtained serial number in hexadecimal representation
    for (size_t i = 0; i < length; i++) {
      (void)snprintf(&dev_id_str[i * 2], sizeof(dev_id_str), "%02x", dev_id[i]);
    }
    dev_str = dev_id_str;
  }

  return dev_str;
}

void memfault_platform_get_device_info(sMemfaultDeviceInfo *info) {
  *info = (sMemfaultDeviceInfo){
    .device_serial = prv_get_device_id(),
    .software_type = "zephyr-app",
    .software_version = APP_VERSION_STRING,
    .hardware_version = CONFIG_BOARD,
  };
}

#if defined(CONFIG_MEMFAULT_FAULT_HANDLER_RETURN)
  #include MEMFAULT_ZEPHYR_INCLUDE(fatal.h)
void k_sys_fatal_error_handler(unsigned int reason, const z_arch_esf_t *esf) {
  printk("User fatal handler invoked with reason: %d. Rebooting!\n", reason);
  memfault_platform_reboot();
}
#endif

int main(void) {
  printk(MEMFAULT_BANNER_COLORIZED);

  LOG_INF("👋 Memfault Demo App! Board %s\n", CONFIG_BOARD);
  memfault_device_info_dump();

  memfault_cdr_register_source(&g_custom_data_recording_source);

#if !defined(CONFIG_MEMFAULT_RECORD_REBOOT_ON_SYSTEM_INIT)
  memfault_zephyr_collect_reset_info();
#endif

  blink_forever();

  return 0;
}
```
